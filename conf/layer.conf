## conf/layer.conf
```bitbake
# We have a conf and classes directory, add to BBPATH
BBPATH .= ":${LAYERDIR}"

# We have recipes-* directories, add to BBFILES
BBFILES += "${LAYERDIR}/recipes-*/*/*.bb \
	${LAYERDIR}/recipes-*/*/*.bbappend"

BBFILE_COLLECTIONS += "dotnet-core"
BBFILE_PATTERN_dotnet-core = "^${LAYERDIR}/"
BBFILE_PRIORITY_dotnet-core = "6"
LAYERDEPENDS_dotnet-core = "core openembedded-layer perl-layer meta-python networking-layer security"
LAYERSERIES_COMPAT_dotnet-core = "honister"
```
